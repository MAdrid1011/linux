## arch/riscv/configs/zircon_defconfig
```kconfig
CONFIG_NO_HZ_IDLE=y
CONFIG_HIGH_RES_TIMERS=y
CONFIG_BLK_DEV_INITRD=y
CONFIG_CC_OPTIMIZE_FOR_SIZE=y
CONFIG_EXPERT=y
# CONFIG_AIO is not set
# CONFIG_IO_URING is not set
# CONFIG_SYSVIPC is not set
# CONFIG_POSIX_MQUEUE is not set
# CONFIG_BSD_PROCESS_ACCT is not set
# CONFIG_IKCONFIG is not set
# CONFIG_SLUB_DEBUG is not set
# CONFIG_INPUT is not set
# CONFIG_HID is not set
# CONFIG_LEGACY_PTYS is not set
# CONFIG_SYSFS_SYSCALL is not set
CONFIG_PRINTK_TIME=y
CONFIG_NONPORTABLE=y
CONFIG_ARCH_RV32I=y
CONFIG_SOC_ZIRCON=y
# CONFIG_SMP is not set
# CONFIG_RISCV_ISA_C is not set
# CONFIG_EFI is not set
CONFIG_FPU=y
CONFIG_RISCV_ISA_F_ONLY=y
CONFIG_RISCV_SBI_V01=y
# CONFIG_MODULES is not set
# CONFIG_BLOCK is not set
# CONFIG_NET is not set
CONFIG_DEVTMPFS=y
CONFIG_DEVTMPFS_MOUNT=y
CONFIG_TTY=y
CONFIG_HVC_RISCV_SBI=y
# CONFIG_VGA_CONSOLE is not set
CONFIG_PROC_FS=y
CONFIG_PROC_CHILDREN=y
CONFIG_SYSFS=y
CONFIG_TMPFS=y
CONFIG_TMPFS_POSIX_ACL=y
CONFIG_COREDUMP=y
# CONFIG_DEBUG_MISC is not set
# CONFIG_FTRACE is not set
# CONFIG_RUNTIME_TESTING_MENU is not set
```
